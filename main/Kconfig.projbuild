## main/Kconfig.projbuild
```kconfig
menu "Snapclient Mesh Project Configuration"

    config MESH_SOFTAP_SSID_PREFIX
        string "Mesh SoftAP SSID prefix"
        default "SnapMesh"
        help
            Praefix fuer die knoteneigenen SoftAP-SSIDs im Mesh.

    config MESH_SOFTAP_PASSWORD
        string "Mesh SoftAP password"
        default "criticalmass"
        help
            Passwort fuer die Inter-Node-SoftAP-Verbindungen (min. 8 Zeichen).
	config MESH_CHANNEL
		int "Mesh Wi-Fi channel"
		default 6
		range 1 13
		help
			Fester WLAN-Kanal des autarken Mesh-Netzes.
			Dieser Wert muss auf Root und allen Clients identisch sein.
			
    config SNAPSERVER_HOST
        string "Snapserver hostname/IP"
        default "192.168.1.10"
        help
            Adresse des Snapcast-Servers.

    config SNAPSERVER_PORT
        int "Snapserver port"
        default 1704
        help
            Snapcast-Stream-Port (Default 1704).

endmenu
```

## sdkconfig.defaults
```kconfig
# ESP32 Mesh Snapclient - project defaults
# ESP-IDF 5.4.3, target: esp32
# Keep only deliberate project overrides here. ESP-IDF generates the full sdkconfig.

# Target/build
CONFIG_IDF_TARGET="esp32"
CONFIG_COMPILER_OPTIMIZATION_SIZE=y
CONFIG_ESP_DEFAULT_CPU_FREQ_MHZ_240=y
CONFIG_FREERTOS_HZ=1000

# Flash and partitions
CONFIG_ESPTOOLPY_FLASHMODE_DIO=y
CONFIG_ESPTOOLPY_FLASHFREQ_40M=y
CONFIG_ESPTOOLPY_FLASHSIZE_4MB=y
CONFIG_PARTITION_TABLE_CUSTOM=y
CONFIG_PARTITION_TABLE_CUSTOM_FILENAME="partitions.csv"
CONFIG_PARTITION_TABLE_FILENAME="partitions.csv"

# Project configuration
CONFIG_MESH_SOFTAP_SSID_PREFIX="SnapMesh_sr"
CONFIG_MESH_SOFTAP_PASSWORD="criticalmass"
CONFIG_SNAPSERVER_HOST="192.168.4.1"
CONFIG_SNAPSERVER_PORT=1704

# Bluetooth Classic A2DP sink
CONFIG_BT_ENABLED=y
CONFIG_BT_BLUEDROID_ENABLED=y
CONFIG_BT_CONTROLLER_ENABLED=y
CONFIG_BT_CLASSIC_ENABLED=y
CONFIG_BT_A2DP_ENABLE=y
CONFIG_BT_AVRCP_ENABLED=y

# A2DP only needs BR/EDR. Disable BLE/GATT and dual-mode overhead.
CONFIG_BTDM_CTRL_MODE_BLE_ONLY=n
CONFIG_BTDM_CTRL_MODE_BR_EDR_ONLY=y
CONFIG_BTDM_CTRL_MODE_BTDM=n
CONFIG_BT_BLE_ENABLED=n
CONFIG_BT_GATTS_ENABLE=n
CONFIG_BT_GATTC_ENABLE=n
CONFIG_BT_BLE_SMP_ENABLE=n
CONFIG_BT_SMP_ENABLE=n

# Cover art uses additional RAM and is not required for audio/control.
CONFIG_BT_AVRCP_CT_COVER_ART_ENABLED=n

# Keep Bluetooth memory requirements bounded for one A2DP source.
CONFIG_BT_ACL_CONNECTIONS=2
CONFIG_BT_MULTI_CONNECTION_ENBALE=n
CONFIG_BTDM_CTRL_BR_EDR_MAX_ACL_CONN=2
CONFIG_BTDM_CTRL_BR_EDR_MAX_SYNC_CONN=0

# Wi-Fi / Mesh-Lite
CONFIG_ESP_WIFI_ENABLED=y
CONFIG_ESP_WIFI_STATIC_RX_BUFFER_NUM=8
CONFIG_ESP_WIFI_DYNAMIC_RX_BUFFER_NUM=32
CONFIG_ESP_WIFI_STATIC_TX_BUFFER=y
CONFIG_ESP_WIFI_STATIC_TX_BUFFER_NUM=16
CONFIG_ESP_WIFI_AMPDU_TX_ENABLED=y
CONFIG_ESP_WIFI_AMPDU_RX_ENABLED=y
CONFIG_ESP_WIFI_RX_BA_WIN=16
CONFIG_ESP_WIFI_TASK_PINNED_TO_CORE_0=y
CONFIG_ESP_WIFI_NVS_ENABLED=y

CONFIG_MESH_LITE_ENABLE=y
CONFIG_MESH_LITE_VENDOR_ID_0=71
CONFIG_MESH_LITE_VENDOR_ID_1=87
CONFIG_MESH_LITE_ID=77
CONFIG_MESH_LITE_MAX_ROUTER_NUMBER=3
CONFIG_MESH_LITE_MAXIMUM_LEVEL_ALLOWED=5
CONFIG_JOIN_MESH_WITHOUT_CONFIGURED_WIFI_INFO=y
CONFIG_DEVICE_CATEGORY="ESP32"

# Network settings used by Mesh-Lite and Snapcast
CONFIG_LWIP_MAX_SOCKETS=10
CONFIG_LWIP_SO_REUSE=y
CONFIG_LWIP_SO_REUSE_RXTOALL=y
CONFIG_LWIP_IP_FORWARD=y
CONFIG_LWIP_IPV4_NAPT=y
CONFIG_LWIP_DHCPS=y
CONFIG_LWIP_DHCPS_MAX_STATION_NUM=8
CONFIG_LWIP_TCP_MSS=1440
CONFIG_LWIP_TCP_SND_BUF_DEFAULT=5760
CONFIG_LWIP_TCP_WND_DEFAULT=16384
CONFIG_LWIP_TCP_RECVMBOX_SIZE=32
CONFIG_LWIP_TCPIP_RECVMBOX_SIZE=32

# PSRAM: retained because this Snapclient is intended to run with PSRAM.
CONFIG_SPIRAM=y
CONFIG_SPIRAM_MODE_QUAD=y
CONFIG_SPIRAM_TYPE_AUTO=y
CONFIG_SPIRAM_SPEED_40M=y
CONFIG_SPIRAM_BOOT_INIT=y
CONFIG_SPIRAM_USE_MALLOC=y
CONFIG_SPIRAM_MALLOC_ALWAYSINTERNAL=16384
CONFIG_SPIRAM_TRY_ALLOCATE_WIFI_LWIP=y
CONFIG_SPIRAM_MALLOC_RESERVE_INTERNAL=32768
CONFIG_SPIRAM_MEMTEST=y

# Runtime diagnostics
CONFIG_ESP_CONSOLE_UART_DEFAULT=y
CONFIG_ESP_CONSOLE_UART_BAUDRATE=115200
CONFIG_LOG_DEFAULT_LEVEL_INFO=y
CONFIG_LOG_MAXIMUM_EQUALS_DEFAULT=y
CONFIG_ESP_TASK_WDT_EN=y
CONFIG_ESP_TASK_WDT_INIT=y
CONFIG_ESP_TASK_WDT_TIMEOUT_S=5
CONFIG_FREERTOS_CHECK_STACKOVERFLOW_CANARY=y
CONFIG_FREERTOS_TIMER_TASK_STACK_DEPTH=6144
```
